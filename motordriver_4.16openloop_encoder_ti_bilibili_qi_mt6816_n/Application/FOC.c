#include "FOC.h"
#include "tim.h"
#include "math.h"
#include "adc.h"
#include "adc_task.h"
//#include "filter.h"
#include "myflash.h"
#include "mt6816.h"
#include "pid.h"

#ifndef M_PI
#define M_PI 3.14159265358979323846
#endif

foc_TypeDef m1_foc;

/* ====================== 参考代码全局变量 ====================== */
extern uint16_t mt6816_count;   // 编码器计数值
uint16_t bias = 0;
int16_t Scope[200];
uint16_t angledata[200] = {0};

extern float current[2];
extern float vol;
extern uint8_t limit_vol;
extern uint32_t add_angle;

/* ====================== 正弦表 ====================== */
float sin_value[1024] = {
0,0.00613588,0.0122715,0.0184067,0.0245412,0.0306748,0.0368072,0.0429383,0.0490677,0.0551952,0.0613207,0.0674439,0.0735646,0.0796824,0.0857973,0.091909,0.0980171,0.104122,0.110222,0.116319,0.122411,0.128498,0.134581,0.140658,0.14673,0.152797,0.158858,0.164913,0.170962,0.177004,0.18304,0.189069,
0.19509,0.201105,0.207111,0.21311,0.219101,0.225084,0.231058,0.237024,0.24298,0.248928,0.254866,0.260794,0.266713,0.272621,0.27852,0.284408,0.290285,0.296151,0.302006,0.30785,0.313682,0.319502,0.32531,0.331106,0.33689,0.342661,0.348419,0.354164,0.359895,0.365613,0.371317,0.377007,
0.382683,0.388345,0.393992,0.399624,0.405241,0.410843,0.41643,0.422,0.427555,0.433094,0.438616,0.444122,0.449611,0.455084,0.460539,0.465976,0.471397,0.476799,0.482184,0.48755,0.492898,0.498228,0.503538,0.50883,0.514103,0.519356,0.52459,0.529804,0.534998,0.540171,0.545325,0.550458,
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-0.19509,-0.189069,-0.18304,-0.177004,-0.170962,-0.164913,-0.158858,-0.152797,-0.14673,-0.140658,-0.134581,-0.128498,-0.122411,-0.116319,-0.110222,-0.104122,-0.0980171,-0.091909,-0.0857973,-0.0796824,-0.0735646,-0.0674439,-0.0613207,-0.0551952,-0.0490677,-0.0429383,-0.0368072,-0.0306748,-0.0245412,-0.0184067,-0.0122715,-0.00613588
};

/* ====================== 你的硬件层：保持不改 ====================== */
// 真OFF：Stop CH + Stop CHN，输出进入 IdleState
static inline void hb_off(TIM_HandleTypeDef *htim, uint32_t ch)
{
    HAL_TIM_PWM_Stop(htim, ch);
    HAL_TIMEx_PWMN_Stop(htim, ch);
}

// LOW：下桥导通（刹车态）
static inline void hb_low(TIM_HandleTypeDef *htim, uint32_t ch)
{
    HAL_TIM_PWM_Start(htim, ch);
    HAL_TIMEx_PWMN_Start(htim, ch);
    __HAL_TIM_SET_COMPARE(htim, ch, 0);
}

// PWM：同相PWM
static inline void hb_pwm(TIM_HandleTypeDef *htim, uint32_t ch, uint16_t duty)
{
    HAL_TIM_PWM_Start(htim, ch);
    HAL_TIMEx_PWMN_Start(htim, ch);
    __HAL_TIM_SET_COMPARE(htim, ch, duty);
}

// 四个半桥封装
static inline void HN1_off(void) { hb_off(&htim1, TIM_CHANNEL_1); }
static inline void HN2_off(void) { hb_off(&htim1, TIM_CHANNEL_2); }
static inline void HN3_off(void) { hb_off(&htim1, TIM_CHANNEL_3); }
static inline void HN4_off(void) { hb_off(&htim8, TIM_CHANNEL_1); }

static inline void HN1_low(void) { hb_low(&htim1, TIM_CHANNEL_1); }
static inline void HN2_low(void) { hb_low(&htim1, TIM_CHANNEL_2); }
static inline void HN3_low(void) { hb_low(&htim1, TIM_CHANNEL_3); }
static inline void HN4_low(void) { hb_low(&htim8, TIM_CHANNEL_1); }

static inline void HN1_set(uint16_t d) { hb_pwm(&htim1, TIM_CHANNEL_1, d); }
static inline void HN2_set(uint16_t d) { hb_pwm(&htim1, TIM_CHANNEL_2, d); }
static inline void HN3_set(uint16_t d) { hb_pwm(&htim1, TIM_CHANNEL_3, d); }
static inline void HN4_set(uint16_t d) { hb_pwm(&htim8, TIM_CHANNEL_1, d); }

void FOC_AllOff(void)
{
    HN1_off();
    HN2_off();
    HN3_off();
    HN4_off();
}

/* ====================== 参考代码算法层 ====================== */

void get_scope(void)   // 从储存获取每个扇区长度
{
    Flash_Read_Angle(angledata);
    Flash_Read_Angle(angledata);

    for(uint8_t i = 0; i < 200; i++)
    {
        if(i != 199)
            Scope[i] = DIR * (int16_t)(angledata[i + 1] - angledata[i]);
        else
            Scope[i] = DIR * (int16_t)(angledata[0] - angledata[i]);

        if(abs(Scope[i]) > 2000)
        {
            Scope[i] = 16384 + Scope[i];
            bias = i;
        }
    }

    Scope[0] = (Scope[0] + Scope[199] + Scope[198] + Scope[197]) * 0.25f;
    Scope[199] = Scope[0];
}

void FOC_Init(void)
{
    if(flash_read_dir(DIR_AD) == 11)
        DIR = 1;
    else
        DIR = -1;

    set_uduq(&m1_foc, 0, 2.4f);
    foc_open(&m1_foc, 0);
    HAL_Delay(100);

    m1_foc.lead_angle = 256;
    get_scope();
}

void Sector_tracker(void)
{
    int temp = (DIR * (mt6816_count / 82) + bias + 200) % 200;

    for(int i = temp - 1; i <= temp + 1; i++)
    {
        int idx = (i + 200) % 200;
        int idxn = (idx + 1) % 200;

        if(DIR == 1)
        {
            if(angledata[idxn] > angledata[idx])
            {
                if(mt6816_count >= angledata[idx] && mt6816_count <= angledata[idxn])
                {
                    m1_foc.angle_sector = idx;
                    break;
                }
            }
            else if(angledata[idxn] < angledata[idx])
            {
                if(mt6816_count >= angledata[idx] && mt6816_count <= (angledata[idxn] + 16384))
                {
                    m1_foc.angle_sector = idx;
                    break;
                }
            }
        }
        else
        {
            if(angledata[idxn] < angledata[idx])
            {
                if(mt6816_count <= angledata[idx] && mt6816_count >= angledata[idxn])
                {
                    m1_foc.angle_sector = idx;
                    break;
                }
            }
            else if(angledata[idxn] > angledata[idx])
            {
                if(mt6816_count <= angledata[idx] && (mt6816_count + 16384) >= angledata[idxn])
                {
                    m1_foc.angle_sector = idx;
                    break;
                }
            }
        }
    }

    m1_foc.scope = Scope[m1_foc.angle_sector];

    if(DIR * angledata[(m1_foc.angle_sector + 1) % 200] > DIR * angledata[m1_foc.angle_sector])
    {
        m1_foc.angle = DIR * (mt6816_count - angledata[m1_foc.angle_sector]) * 256 / m1_foc.scope;
    }
    else
    {
        if(DIR == 1)
        {
            if(mt6816_count > 16200)
                m1_foc.angle = (mt6816_count - angledata[m1_foc.angle_sector]) * 256 / m1_foc.scope;
            else
                m1_foc.angle = (16384 - angledata[m1_foc.angle_sector] + mt6816_count) * 256 / m1_foc.scope;
        }
        else
        {
            if(mt6816_count > 16200)
                m1_foc.angle = (16384 + angledata[m1_foc.angle_sector] - mt6816_count) * 256 / m1_foc.scope;
            else
                m1_foc.angle = (-mt6816_count + angledata[m1_foc.angle_sector]) * 256 / m1_foc.scope;
        }
    }
}

void setfoc_angle(foc_TypeDef *mfoc, uint16_t angle)
{
    mfoc->sintheta = sin_value[angle & 0x03ff];
    mfoc->costheta = sin_value[(angle + 256) % 1024];
}

void repark_transfer(foc_TypeDef *mfoc)
{
    mfoc->Ualpha = mfoc->costheta * mfoc->Ud - mfoc->sintheta * mfoc->Uq;
    mfoc->Ubeta  = mfoc->sintheta * mfoc->Ud + mfoc->costheta * mfoc->Uq;
}

void svpwmctr(foc_TypeDef *mfoc)
{
    float ualpha = fabsf(mfoc->Ualpha);
    float ubeta  = fabsf(mfoc->Ubeta);

    if(mfoc->Ualpha >= 0 && mfoc->Ubeta >= 0)
        mfoc->sector = 1;
    else if(mfoc->Ualpha < 0 && mfoc->Ubeta >= 0)
        mfoc->sector = 2;
    else if(mfoc->Ualpha < 0 && mfoc->Ubeta < 0)
        mfoc->sector = 3;
    else if(mfoc->Ualpha >= 0 && mfoc->Ubeta < 0)
        mfoc->sector = 4;

    mfoc->Ta = (uint16_t)(ualpha / mfoc->Udc * mfoc->Ts);
    mfoc->Tb = (uint16_t)(ubeta  / mfoc->Udc * mfoc->Ts);
}

void set_duty_by_sector(foc_TypeDef *mfoc)
{
    switch(mfoc->sector)
    {
        case 1:
            HN1_set(0);         HN2_set(mfoc->Ta);
            HN3_set(0);         HN4_set(mfoc->Tb);
            break;

        case 2:
            HN2_set(0);         HN1_set(mfoc->Ta);
            HN3_set(0);         HN4_set(mfoc->Tb);
            break;

        case 3:
            HN2_set(0);         HN1_set(mfoc->Ta);
            HN4_set(0);         HN3_set(mfoc->Tb);
            break;

        case 4:
            HN1_set(0);         HN2_set(mfoc->Ta);
            HN4_set(0);         HN3_set(mfoc->Tb);
            break;

        default:
            break;
    }
}

void set_uduq(foc_TypeDef *mfoc, float ud, float uq)
{
    if(ud > mfoc->outmax) return;
    else if(ud < -mfoc->outmax) return;

    if(uq > mfoc->outmax) return;
    else if(uq < -mfoc->outmax) return;

    mfoc->Ud = ud;
    mfoc->Uq = uq;
}

void foc_open(foc_TypeDef *mfoc, uint16_t angle)
{
    setfoc_angle(mfoc, angle);
    repark_transfer(mfoc);
    svpwmctr(mfoc);
    set_duty_by_sector(mfoc);
}

void park_transform(foc_TypeDef *mfoc)
{
    mfoc->Iq = -mfoc->Ialpha * mfoc->sintheta + mfoc->Ibeta * mfoc->costheta;
    mfoc->Id =  mfoc->Ialpha * mfoc->costheta + mfoc->Ibeta * mfoc->sintheta;
}

void get_AB_current(foc_TypeDef *mfoc)
{
    current[0] = ADCtoI * HAL_ADCEx_InjectedGetValue(&hadc1, ADC_INJECTED_RANK_1) - offet_I[0];
    current[1] = ADCtoI * HAL_ADCEx_InjectedGetValue(&hadc1, ADC_INJECTED_RANK_2) - offet_I[1];

    switch(mfoc->sector)
    {
        case 1:
            m1_foc.Ialpha = current[0];
            m1_foc.Ibeta  = current[1];
            break;
        case 2:
            m1_foc.Ialpha = -current[0];
            m1_foc.Ibeta  = current[1];
            break;
        case 3:
            m1_foc.Ialpha = -current[0];
            m1_foc.Ibeta  = -current[1];
            break;
        case 4:
            m1_foc.Ialpha = current[0];
            m1_foc.Ibeta  = -current[1];
            break;
        default:
            break;
    }
}

float PID_factor = 1.0f;

void adjust_I(void)
{
    current[0] = ADCtoI * HAL_ADCEx_InjectedGetValue(&hadc1, ADC_INJECTED_RANK_1);
    current[1] = ADCtoI * HAL_ADCEx_InjectedGetValue(&hadc1, ADC_INJECTED_RANK_2);
}

void can_foc_init(void)
{
    m1_foc.Ts = 1800;
    m1_foc.Udc = 24;
    m1_foc.outmax = 20;

    if(PID_factor > 2 || PID_factor < 0.5f) PID_factor = 1;

    m1_foc.kp = (3 - vol * 0.06f) * PID_factor;
    m1_foc.ki = (0.06f - vol * 0.001f) * PID_factor;
    m1_foc.kd = 0.0f;

    m1_foc.tar_Id = 0;
    m1_foc.tar_Iq = 0.5f;

    m1_foc.id_err = 0;
    m1_foc.iq_err = 0;
    m1_foc.id_inter = 0;
    m1_foc.iq_inter = 0;

    m1_foc.Ls = 0.0041f;
    m1_foc.FLux = 0.002f;
}

void b_foc_init(void)
{
    PID_factor = (*(__IO uint32_t *)(FLASH_USER_START_ADDR + 0x800)) * 0.01f;
    can_foc_init();
    FOC_Init();

    set_uduq(&m1_foc, 0, 0);
    foc_open(&m1_foc, 0);

    for(uint8_t jj = 0; jj < 250; jj++)
    {
        add_angle += (uint32_t)REIN_MT6816_GetAngleData();
        HAL_Delay(1);
    }

    encoder_last_count = mt6816_count = init_angle = add_angle / 250;
}

void set_foc_Iqcurrent(foc_TypeDef *mfoc, float current_set)
{
    if(current_set > System_MAX_I) current_set = System_MAX_I;
    else if(current_set < -System_MAX_I) current_set = -System_MAX_I;

    mfoc->tar_Iq = current_set;
}

#define Omax 10

void foc_current_pid(foc_TypeDef *mfoc)
{
    mfoc->id_err = mfoc->tar_Id - mfoc->Id;
    mfoc->iq_err = mfoc->tar_Iq - mfoc->Iq;

    mfoc->id_inter += mfoc->ki * mfoc->id_err;
    mfoc->iq_inter += mfoc->ki * mfoc->iq_err;

    if(mfoc->id_inter > limit_vol)  mfoc->id_inter = limit_vol;
    if(mfoc->id_inter < -limit_vol) mfoc->id_inter = -limit_vol;

    if(mfoc->iq_inter > limit_vol)  mfoc->iq_inter = limit_vol;
    if(mfoc->iq_inter < -limit_vol) mfoc->iq_inter = -limit_vol;

    mfoc->Ud = mfoc->kp * mfoc->id_err + mfoc->id_inter + mfoc->kd * (mfoc->id_err - mfoc->last_Id_err);
    mfoc->Uq = mfoc->kp * mfoc->iq_err + mfoc->iq_inter + mfoc->kd * (mfoc->iq_err - mfoc->last_Iq_err);

    if(mfoc->Ud > 6) mfoc->Ud = 6;
    if(mfoc->Ud < -6) mfoc->Ud = -6;

    if(mfoc->Uq > Omax) mfoc->Uq = Omax;
    if(mfoc->Uq < -Omax) mfoc->Uq = -Omax;

    mfoc->last_Id_err = mfoc->id_err;
    mfoc->last_Iq_err = mfoc->iq_err;
}

void current_ctr(foc_TypeDef *mfoc, uint16_t angle)
{
    setfoc_angle(mfoc, angle);
    park_transform(mfoc);
    foc_current_pid(mfoc);
    repark_transfer(mfoc);
    svpwmctr(mfoc);
    set_duty_by_sector(mfoc);
}
#include "app_printer.h"
#include "usart.h"
#include <string.h>

#define PRINTER_UART_CHUNK_SIZE 128U
#define PRINTER_UART_CHUNK_TIMEOUT_MS 2000U

static void AppPrinter_SetLocalBaud(uint32_t baudRate)
{
  HAL_UART_DeInit(&huart5);
  huart5.Init.BaudRate = baudRate;
  HAL_UART_Init(&huart5);
}

void AppPrinter_InitBaud115200(void)
{
  static const char setBaudZpl[] =
    "^XA\r\n"
    "^SC115200,8,N,1,N,N\r\n"
    "^JUS\r\n"
    "^XZ\r\n";

  AppPrinter_SetLocalBaud(9600);
  AppPrinter_SendBytes((const uint8_t *)setBaudZpl, (uint32_t)strlen(setBaudZpl));
  HAL_Delay(800);
  AppPrinter_SetLocalBaud(115200);
  HAL_Delay(200);
}

void AppPrinter_SendBytes(const uint8_t *data, uint32_t size)
{
  uint32_t offset = 0;

  if (data == 0 || size == 0)
  {
    return;
  }

  while (offset < size)
  {
    uint16_t chunk = (uint16_t)(size - offset);

    if (chunk > PRINTER_UART_CHUNK_SIZE)
    {
      chunk = PRINTER_UART_CHUNK_SIZE;
    }

    if (HAL_UART_Transmit(&huart5,
                          (uint8_t *)&data[offset],
                          chunk,
                          PRINTER_UART_CHUNK_TIMEOUT_MS) != HAL_OK)
    {
      return;
    }

    offset += chunk;
  }
}

void AppPrinter_SendZpl(const char *zpl)
{
  if (zpl == 0)
  {
    return;
  }

  AppPrinter_SendBytes((const uint8_t *)zpl, (uint32_t)strlen(zpl));
}

uint16_t AppPrinter_QueryHostStatus(uint8_t *buffer, uint16_t bufferSize, uint32_t timeoutMs)
{
  static const char query[] = "~HS\r\n";
  uint16_t received = 0;
  uint32_t startTick = HAL_GetTick();
  uint8_t data = 0;

  if (buffer == 0 || bufferSize == 0)
  {
    return 0;
  }

  buffer[0] = 0;
  AppPrinter_SendBytes((const uint8_t *)query, (uint32_t)strlen(query));

  while ((HAL_GetTick() - startTick) < timeoutMs && received < (uint16_t)(bufferSize - 1U))
  {
    if (HAL_UART_Receive(&huart5, &data, 1, 50) == HAL_OK)
    {
      buffer[received++] = data;
      buffer[received] = 0;
    }
    else if (received > 0)
    {
      break;
    }
  }

  return received;
}

static uint8_t AppPrinter_CopyStatusLine(const uint8_t *buffer,
                                         uint16_t size,
                                         uint8_t lineIndex,
                                         char *line,
                                         uint16_t lineSize)
{
  uint16_t i;
  uint16_t pos = 0;
  uint8_t currentLine = 0;
  uint8_t gotData = 0;

  if (buffer == 0 || line == 0 || lineSize == 0)
  {
    return 0;
  }

  line[0] = 0;

  for (i = 0; i < size; i++)
  {
    uint8_t ch = buffer[i];

    if (ch == '\r' || ch == '\n')
    {
      if (currentLine == lineIndex && gotData)
      {
        line[pos] = 0;
        return 1;
      }

      if (gotData)
      {
        currentLine++;
        gotData = 0;
        pos = 0;
      }
      continue;
    }

    if (ch == 0x02 || ch == 0x03)
    {
      continue;
    }

    if (currentLine == lineIndex)
    {
      if ((ch >= '0' && ch <= '9') || ch == ',')
      {
        if (pos < (uint16_t)(lineSize - 1U))
        {
          line[pos++] = (char)ch;
          line[pos] = 0;
          gotData = 1;
        }
      }
    }
    else if ((ch >= '0' && ch <= '9') || ch == ',')
    {
      gotData = 1;
    }
  }

  if (currentLine == lineIndex && gotData)
  {
    line[pos] = 0;
    return 1;
  }

  return 0;
}

static uint8_t AppPrinter_GetCsvField(const char *line,
                                      uint8_t fieldIndex,
                                      char *field,
                                      uint8_t fieldSize)
{
  uint8_t currentField = 0;
  uint8_t pos = 0;
  const char *p = line;

  if (line == 0 || field == 0 || fieldSize == 0)
  {
    return 0;
  }

  field[0] = 0;

  while (*p != 0)
  {
    if (*p == ',')
    {
      if (currentField == fieldIndex)
      {
        field[pos] = 0;
        return 1;
      }

      currentField++;
      pos = 0;
      p++;
      continue;
    }

    if (currentField == fieldIndex)
    {
      if (pos < (uint8_t)(fieldSize - 1U))
      {
        field[pos++] = *p;
        field[pos] = 0;
      }
    }

    p++;
  }

  return (currentField == fieldIndex);
}

static uint8_t AppPrinter_FieldEquals(const char *line, uint8_t index, const char *expected)
{
  char field[12];

  if (!AppPrinter_GetCsvField(line, index, field, sizeof(field)))
  {
    return 0;
  }

  return (strcmp(field, expected) == 0);
}

uint8_t AppPrinter_IsHostStatusDone(const uint8_t *buffer, uint16_t size)
{
  char line1[80];
  char line2[80];

  if (!AppPrinter_CopyStatusLine(buffer, size, 0, line1, sizeof(line1)))
  {
    return 0;
  }

  if (!AppPrinter_CopyStatusLine(buffer, size, 1, line2, sizeof(line2)))
  {
    return 0;
  }

  /* ~HS line 1:
     b=media out, c=pause, eee=formats in receive buffer,
     f=buffer full, h=partial format, j=RAM corrupt, k/l=temp out of range. */
  if (!AppPrinter_FieldEquals(line1, 1, "0")) return 0;
  if (!AppPrinter_FieldEquals(line1, 2, "0")) return 0;
  if (!AppPrinter_FieldEquals(line1, 4, "000")) return 0;
  if (!AppPrinter_FieldEquals(line1, 5, "0")) return 0;
  if (!AppPrinter_FieldEquals(line1, 7, "0")) return 0;
  if (!AppPrinter_FieldEquals(line1, 9, "0")) return 0;
  if (!AppPrinter_FieldEquals(line1, 10, "0")) return 0;
  if (!AppPrinter_FieldEquals(line1, 11, "0")) return 0;

  /* ~HS line 2:
     o=head open, p=ribbon out, t=label waiting in peel/applicator modes. */
  if (!AppPrinter_FieldEquals(line2, 2, "0")) return 0;
  if (!AppPrinter_FieldEquals(line2, 3, "0")) return 0;
  if (!AppPrinter_FieldEquals(line2, 7, "0")) return 0;

  return 1;
}

uint8_t AppPrinter_WaitDone(uint32_t timeoutMs, uint32_t intervalMs)
{
  uint8_t status[256];
  uint16_t statusLen;
  uint32_t startTick = HAL_GetTick();
  uint8_t readyCount = 0;

  while ((HAL_GetTick() - startTick) < timeoutMs)
  {
    statusLen = AppPrinter_QueryHostStatus(status, sizeof(status), 800);

    if (statusLen > 0 && AppPrinter_IsHostStatusDone(status, statusLen))
    {
      readyCount++;
      if (readyCount >= 2)
      {
        return 1;
      }
    }
    else
    {
      readyCount = 0;
    }

    HAL_Delay(intervalMs);
  }

  return 0;
}

void AppPrinter_TestPrint(void)
{
  static const char zpl[] =
    "^XA\r\n"
    "^PW1417\r\n"
    "^LL945\r\n"
    "^PR1,1\r\n"
    "~SD22\r\n"
    "^CI28\r\n"
    "^LH120,45\r\n"
    "^CWZ,E:SIMSUN.TTF\r\n"
    "\r\n"

    "^FO118,35^GFA,4074,4074,42,"
    "000000000000060000000000000000000000000000000000000000000000000000000000000000000000000000000000"
    "03800000000000000000000000000000000000000000000000000000000000000000000000000000000001E000000000"
    "000000000000000000000000000000000000000000000000000000000000000000000000007800000000000000000000"
    "000000000000000000000000000000000000000000000000000000000000003E00000000000000000000000000000000"
    "000000000000000000000000000000000000000000000000000F80000000000000000000000000000000000000000000"
    "0000000000000000000000000000000000000007E0000000000000000000000000000000000000000000000000000000"
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    "0000000000000000000000000000000000003E0000000000000000000000000000000000000000000000000000000000"
    "000000000000000000000000780000000000000000000000000000000000000000000000000000000000000000000000"
    "000000000000E00000000000000000000000000000000000000000000000000000000000000000000000000000000000"
    "C00000000000000000000000000000000000000000000000000000000000000000000000000000000000"
    "^FS\r\n"


    "^FO455,78^A@N,56,56,E:SIMSUN.TTF^FH_^FD_E4_B8_80_E8_8B_87_E7_A7_91_E6_8A_80^FS\r\n"

    "^FO825,45^A@N,60,60,E:SIMSUN.TTF^FH_^FD_E5_9C_A8_E7_BA_BF_E6_89_93_E5_8D_B0_E7_B3_BB_E5_88_97^FS\r\n"
    "^FO827,45^A@N,60,60,E:SIMSUN.TTF^FH_^FD_E5_9C_A8_E7_BA_BF_E6_89_93_E5_8D_B0_E7_B3_BB_E5_88_97^FS\r\n"

    "^FO120,133^GB1150,8,8^FS\r\n"

    "^FO120,200^A@N,60,60,E:SIMSUN.TTF^FH_^FD_E5_90_8D_E7_A7_B0_3A_E4_B8_80_E8_8B_87_E7_A7_91_E6_8A_80_E5_9C_A8_E7_BA_BF_E6_89_93_E5_8D_B0_E6_9C_BA^FS\r\n"
    "^FO123,200^A@N,60,60,E:SIMSUN.TTF^FH_^FD_E5_90_8D_E7_A7_B0_3A_E4_B8_80_E8_8B_87_E7_A7_91_E6_8A_80_E5_9C_A8_E7_BA_BF_E6_89_93_E5_8D_B0_E6_9C_BA^FS\r\n"

    "^FO120,325^A@N,47,47,E:SIMSUN.TTF^FH_^FD_E5_9E_8B_E5_8F_B7_3A_41_52_44_2D_31_30_34_33_2D_51_54_2D_56_31_2E_30^FS\r\n"
    "^FO690,325^A@N,47,47,E:SIMSUN.TTF^FH_^FD_E7_B1_BB_E5_9E_8B_3A_E7_83_AD_E8_BD_AC_2F_E7_83_AD_E6_95_8F_E6_89_93_E5_8D_B0^FS\r\n"

    "^FO120,438^A@N,47,47,E:SIMSUN.TTF^FH_^FD_E5_B0_BA_E5_AF_B8_3A_32_35_2A_36_30_2A_6D_6D^FS\r\n"
    "^FO690,438^A@N,47,47,E:SIMSUN.TTF^FH_^FD_E6_9D_90_E8_B4_A8_3A_E6_A0_87_E7_AD_BE_E7_BA_B8^FS\r\n"

    "^FO120,530^GB1150,8,8^FS\r\n"

    "^FO120,610^A@N,47,47,E:SIMSUN.TTF^FH_^FD_E5_87_BA_E5_8E_82_E6_97_A5_E6_9C_9F_3A_32_30_32_36_E5_B9_B4_35_E6_9C_88_32_30_E6_97_A5^FS\r\n"
    "^FO120,700^A@N,47,47,E:SIMSUN.TTF^FH_^FD_E6_89_B9_E6_AC_A1_E5_8F_B7_3A_59_57_30_35_32_30_30_30_31^FS\r\n"

    "^FO120,785^GB590,8,8^FS\r\n"
    "^FO120,845^A@N,41,41,E:SIMSUN.TTF^FH_^FD_E9_80_89_E5_9E_8B_E5_B9_B3_E5_8F_B0_3A_77_77_77_2E_66_65_65_64_65_72_78_2E_63_6E^FS\r\n"

    "^FO1025,595^BQN,2,8\r\n"
    "^FDLA,https://www.feederx.cn^FS\r\n"

    "^FO1000,850^FB260,1,0,C^A@N,33,33,E:SIMSUN.TTF^FH_^FD_E5_AE_98_E6_96_B9_E7_BD_91_E7_AB_99^FS\r\n"
    "^FO1002,850^FB260,1,0,C^A@N,33,33,E:SIMSUN.TTF^FH_^FD_E5_AE_98_E6_96_B9_E7_BD_91_E7_AB_99^FS\r\n"

    "^PQ1\r\n"
    "^XZ\r\n";

  AppPrinter_SendZpl(zpl);
}
